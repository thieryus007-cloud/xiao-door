## CMakeLists.txt
```
cmake_minimum_required(VERSION 3.20.0)

find_package(Zephyr REQUIRED HINTS $ENV{ZEPHYR_BASE})
project(xiao_nrf52840_dk_bench)

target_sources(app PRIVATE src/main.c)
```

## prj.conf
```kconfig
# Firmware minimal de comparaison -- nRF52840 DK nue (PCA10056 v3.0.3),
# voir Transition-nRF52840-Optimisation-Consommation.md (projet
# xiao_nrf52840_door_sensor) pour le contexte complet : isoler si les pics
# ~20-25 ms mesurés au repos sur la XIAO nRF52840 Sense sont génériques au
# SoC nRF52840/Zephyr/NCS v3.4.0, ou spécifiques à cette carte XIAO.
#
# Reproduit uniquement les sous-systèmes actifs dans la config finale XIAO
# (BLE actif, logging/console/série/USB désactivés, System ON) -- sans
# IMU/I2C/ADC/QSPI, absents sur cette carte.
CONFIG_BT=y
CONFIG_BT_BROADCASTER=y
CONFIG_BT_DEVICE_NAME="DK-BENCH"

CONFIG_STDOUT_CONSOLE=n
CONFIG_LOG=n
CONFIG_CONSOLE=n
CONFIG_SERIAL=n
CONFIG_USB_DEVICE_STACK=n

# Sans effet connu sur nRF52840/NCS v3.4.0 (CONFIG_PM dépend de HAS_PM,
# non sélectionné par les Kconfig nrf52 -- voir doc de transition), gardé
# ici uniquement pour reproduire l'intention de la config finale XIAO.
CONFIG_PM=y
```

## src/main.c
```c
#include <zephyr/kernel.h>
#include <zephyr/bluetooth/bluetooth.h>

#define IDLE_SLEEP_MS 1000

int main(void)
{
	int err = bt_enable(NULL);

	if (err) {
		return err;
	}

	while (1) {
		k_sleep(K_MSEC(IDLE_SLEEP_MS));
	}

	return 0;
}
```
