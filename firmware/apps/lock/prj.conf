## CMakeLists.txt
```
#
# Copyright (c) 2021 Nordic Semiconductor ASA
#
# SPDX-License-Identifier: LicenseRef-Nordic-5-Clause
#

cmake_minimum_required(VERSION 3.20.0)

find_package(Zephyr REQUIRED HINTS $ENV{ZEPHYR_BASE})
project(matter-lock)

# Enable GNU STD support.
include(${ZEPHYR_CONNECTEDHOMEIP_MODULE_DIR}/config/nrfconnect/app/enable-gnu-std.cmake)

# NORDIC SDK APP START

# Include all source files that are located in the Matter common directory.
include(${ZEPHYR_NRF_MODULE_DIR}/samples/matter/common/cmake/source_common.cmake)

# Include Data Model utils
include(${ZEPHYR_NRF_MODULE_DIR}/samples/matter/common/cmake/data_model.cmake)

include(${ZEPHYR_NRF_MODULE_DIR}/samples/matter/common/cmake/zap_helpers.cmake)
ncs_get_zap_parent_dir(ZAP_PARENT_DIR)

target_include_directories(app PRIVATE
  src
  ${ZAP_PARENT_DIR}
)

SET(access_srcs
  src/access/access_data_types.cpp
  src/access/access_manager_credentials.cpp
  src/access/access_manager_users.cpp
  src/access/access_manager.cpp
  src/access/access_storage.cpp
)

if(CONFIG_LOCK_SCHEDULES)
  LIST(APPEND access_srcs src/access/access_manager_schedules.cpp)
endif()

target_sources(app PRIVATE
  src/app_task.cpp
  src/bolt_lock_manager.cpp
  src/imu_manager.cpp
  src/main.cpp
  src/zcl_callbacks.cpp
  ${access_srcs}
)

if(CONFIG_THREAD_WIFI_SWITCHING)
  target_sources(app PRIVATE
    src/thread_wifi_switch.cpp
  )
endif()

# Do not treat warnings as errors while the variable may be uninitialized for this sample data model.
# In the door-lock-server implementation, there is a warning that the C++ "optional"
# variable may be uninitialized, but actually, it is wrongly interpreted by the Zephyr toolchain.
target_compile_options(matter-data-model PRIVATE -Wno-error=maybe-uninitialized)

ncs_configure_data_model()

# NORDIC SDK APP END
```

## prj.conf
```kconfig
#
# Copyright (c) 2022 Nordic Semiconductor ASA
#
# SPDX-License-Identifier: LicenseRef-Nordic-5-Clause
#

# This sample uses Kconfig.defaults to set options common for all
# samples. This file should contain only options specific for this sample
# or overrides of default values.

# Enable CHIP
CONFIG_CHIP=y
CONFIG_CHIP_PROJECT_CONFIG="src/chip_project_config.h"
CONFIG_CHIP_DEVICE_PRODUCT_NAME="Matter Door Lock"

# Configure ZAP file name
CONFIG_NCS_SAMPLE_MATTER_ZAP_FILE_PATH="${APPLICATION_CONFIG_DIR}/src/default_zap/lock.zap"

# 32774 == 0x8006 (example lock-app)
CONFIG_CHIP_DEVICE_PRODUCT_ID=32774
CONFIG_STD_CPP17=y

# Enable Matter extended announcement and increase duration to 1 hour.
CONFIG_CHIP_BLE_EXT_ADVERTISING=y
CONFIG_CHIP_BLE_ADVERTISING_DURATION=60

# Add support for LEDs and buttons on Nordic development kits
CONFIG_DK_LIBRARY=y

# Bluetooth Low Energy configuration
CONFIG_BT_DEVICE_NAME="MatterLock"

# Suspend devices when the CPU goes into sleep
CONFIG_PM_DEVICE=y

# Other settings
CONFIG_THREAD_NAME=y
CONFIG_MPU_STACK_GUARD=y
CONFIG_RESET_ON_FATAL_ERROR=n
CONFIG_CHIP_LIB_SHELL=y
CONFIG_NCS_SAMPLE_MATTER_TEST_SHELL=y

# Reduce application size
CONFIG_USE_SEGGER_RTT=n
CONFIG_MATTER_LOG_LEVEL_INF=y
CONFIG_CHIP_APP_LOG_LEVEL=3

# Enable Factory Data feature
CONFIG_CHIP_FACTORY_DATA=y
CONFIG_CHIP_FACTORY_DATA_BUILD=y

# Ouvre la fenêtre de commissioning BLE automatiquement au boot si l'appareil
# n'est pas encore commissionné (CHIP_ENABLE_PAIRING_AUTOSTART vaut "n" par
# défaut dans le Kconfig nRF Connect SDK, choix de conception Nordic pour
# l'économie d'énergie, pas un bug — voir KNOWN-ISSUES.md). Fusionné ici
# depuis l'ancien pairing-autostart.conf maintenant que l'app est forkée
# dans le repo.
CONFIG_CHIP_ENABLE_PAIRING_AUTOSTART=y

# IMU LSM6DS3TR-C (Priorité 2) — lecture 6 axes en polling (imu_manager.cpp).
# CONFIG_REGULATOR active le driver nPM1300 dont dépend le "regulator-boot-on"
# du régulateur imu_vdd (voir boards/....overlay -- nécessaire pour que le
# capteur soit déjà alimenté quand son propre driver s'initialise au boot).
CONFIG_SENSOR=y
CONFIG_LSM6DSL=y
CONFIG_REGULATOR=y

# ODR par défaut à la valeur "runtime" (0) laisserait le capteur en power-down
# tant que l'appli n'appelle pas explicitement sensor_attr_set() -- on préfère
# une fréquence fixe configurée par le driver lui-même dès le boot (index 2 =
# 26 Hz, largement suffisant pour un polling applicatif toutes les 2s).
CONFIG_LSM6DSL_ACCEL_ODR=2
CONFIG_LSM6DSL_GYRO_ODR=2
```

## debug-rtt.conf
```kconfig
# Fragment de debug — active les logs via Segger RTT (lisible par OpenOCD
# sur la sonde CMSIS-DAP intégrée, sans matériel supplémentaire).
# Usage : -DEXTRA_CONF_FILE=firmware/apps/lock/debug-rtt.conf
CONFIG_USE_SEGGER_RTT=y
CONFIG_LOG_BACKEND_RTT=y
CONFIG_RTT_CONSOLE=y
CONFIG_UART_CONSOLE=n
# Désactivé pour garder le CPU/RAM éveillés pendant le débogage —
# la gestion d'énergie semble faire perdre la session RTT/SWD.
CONFIG_PM_DEVICE=n
CONFIG_PM=n
```

## legacy-ble.conf
```kconfig
# Fragment de diagnostic — force la publicité BLE classique (legacy)
# au lieu de l'extended advertising (activé par défaut dans le sample),
# pour vérifier avec un scanner BLE générique si l'appareil émet bien.
# Usage : -DEXTRA_CONF_FILE=firmware/apps/lock/legacy-ble.conf
CONFIG_CHIP_BLE_EXT_ADVERTISING=n
CONFIG_CHIP_BLE_ADVERTISING_DURATION=15
```

## pairing-autostart.conf
```kconfig
# Ouvre la fenêtre de commissioning BLE automatiquement au boot si l'appareil
# n'est pas encore commissionné, au lieu d'exiger un appui bouton.
#
# CHIP_ENABLE_PAIRING_AUTOSTART vaut "n" par défaut dans le Kconfig nRF
# Connect SDK (config/zephyr/Kconfig) — contrairement au défaut de la lib
# CHIP amont (CHIP_DEVICE_CONFIG_ENABLE_PAIRING_AUTOSTART=1). C'est un choix
# de conception Nordic (économie d'énergie), pas un bug : sans ce flag, il
# faut appuyer sur le bouton BLE (BLUETOOTH_ADV_BUTTON, voir board_config.h)
# pour déclencher StartBLEAdvertisement() -> OpenBasicCommissioningWindow().
#
# Sur cette board custom, un seul bouton physique existe (button0, voir
# xiao_nrf54lm20a_nrf54lm20a-common.dtsi) et FUNCTION_BUTTON/BLUETOOTH_ADV_BUTTON
# y sont tous les deux mappés (board_config.h) — donc un appui court dessus
# devrait aussi fonctionner. Ce flag est un confort pour ne pas dépendre
# de cette manipulation physique lors du commissioning des ~20 unités.
#
# Usage : -DEXTRA_CONF_FILE=firmware/apps/lock/pairing-autostart.conf
CONFIG_CHIP_ENABLE_PAIRING_AUTOSTART=y
```

## sw-split-ble.conf
```kconfig
# Utilise le contrôleur Bluetooth LE logiciel de Zephyr (expérimental) au lieu
# de la SoftDevice Controller de Nordic — test pour contourner
# https://github.com/Seeed-Studio/platform-seeedboards/issues/65
CONFIG_BT_LL_SOFTDEVICE=n
CONFIG_BT_LL_SW_SPLIT=y
```

## boards/xiao_nrf54lm20a_nrf54lm20a_cpuapp-sw-split.overlay
```dts
/*
 * Bascule le contrôleur Bluetooth LE de la SoftDevice Controller de Nordic
 * vers le contrôleur logiciel de Zephyr (bt_hci_controller / sw-split),
 * en test pour contourner https://github.com/Seeed-Studio/platform-seeedboards/issues/65
 * (BLE ne diffuse jamais réellement avec la SoftDevice Controller sur ce SoC).
 */

&bt_hci_sdc {
	status = "disabled";
};

&bt_hci_controller {
	status = "okay";
};

/ {
	chosen {
		zephyr,bt-hci = &bt_hci_controller;
	};
};
```

## boards/xiao_nrf54lm20a_nrf54lm20a_cpuapp.overlay
```dts
/*
 * Overlay Matter Door Lock pour XIAO nRF54LM20A Sense.
 * Active la flash externe (py25q64, 8 MB) requise par le partitionnement
 * Matter (secondary slot MCUboot + OTA), sur le modèle de l'overlay officiel
 * Nordic pour nrf54lm20dk_nrf54lm20a_cpuapp (mx25r64 -> py25q64).
 */

/ {
	chosen {
		nordic,pm-ext-flash = &py25q64;
	};
};

&py25q64 {
	status = "okay";
};

/*
 * L'IMU (lsm6ds3tr_c, voir nrf54lm20a_cpuapp_common.dtsi) est alimentée par le
 * régulateur LDO1 du nPM1300 (imu_vdd), qui est éteint au démarrage par défaut.
 * Nécessaire mais actuellement PAS SUFFISANT pour que l'IMU fonctionne : le
 * driver MFD du nPM1300 lui-même échoue en amont (voir "PMIC I2C : bug non
 * résolu" dans KNOWN-ISSUES.md) -- imu_vdd ne peut donc jamais s'activer tant
 * que ce bug plus profond n'est pas corrigé. Cette config reste correcte et
 * nécessaire pour le jour où le bug PMIC sera résolu.
 */
&imu_vdd {
	regulator-boot-on;
	startup-delay-us = <5000>;
};
```

## src/app_task.cpp
```c
/*
 * Copyright (c) 2021 Nordic Semiconductor ASA
 *
 * SPDX-License-Identifier: LicenseRef-Nordic-5-Clause
 */

#include "app_task.h"
#include "bolt_lock_manager.h"
#include "clusters/identify.h"
#include "imu_manager.h"

#ifdef CONFIG_THREAD_WIFI_SWITCHING
#include "thread_wifi_switch.h"
#endif

#include "app/matter_init.h"
#include "app/task_executor.h"

#ifdef CONFIG_CHIP_NUS
#include "bt_nus/bt_nus_service.h"
#endif

#include <app-common/zap-generated/attributes/Accessors.h>
#include <app/clusters/door-lock-server/door-lock-server.h>
#include <platform/CHIPDeviceLayer.h>
#include <setup_payload/OnboardingCodesUtil.h>

#include <zephyr/logging/log.h>

LOG_MODULE_DECLARE(app, CONFIG_CHIP_APP_LOG_LEVEL);

using namespace ::chip;
using namespace ::chip::app;
using namespace ::chip::DeviceLayer;

namespace
{
constexpr EndpointId kLockEndpointId = 1;

#ifdef CONFIG_CHIP_NUS
constexpr uint16_t kAdvertisingIntervalMin = 400;
constexpr uint16_t kAdvertisingIntervalMax = 500;
constexpr uint8_t kLockNUSPriority = 2;
#endif

#ifdef CONFIG_THREAD_WIFI_SWITCHING
k_timer sSwitchTransportTimer;
constexpr uint32_t kSwitchTransportTimeout = 10000;
#endif

#define APPLICATION_BUTTON_MASK DK_BTN2_MSK
#define SWITCHING_BUTTON_MASK DK_BTN3_MSK

#ifndef CONFIG_CHIP_FACTORY_RESET_ERASE_SETTINGS
void AppFactoryResetHandler(const ChipDeviceEvent *event, intptr_t /* unused */)
{
	switch (event->Type) {
	case DeviceEventType::kFactoryReset:
		BoltLockMgr().FactoryReset();
		break;
	default:
		break;
	}
}
#endif

Nrf::Matter::IdentifyCluster sIdentifyCluster(kLockEndpointId, false, []() {
	Nrf::PostTask([] { Nrf::GetBoard().GetLED(Nrf::DeviceLeds::LED2).Set(BoltLockMgr().IsLocked()); });
});
} /* namespace */

void AppTask::ButtonEventHandler(Nrf::ButtonState state, Nrf::ButtonMask hasChanged)
{
	if ((APPLICATION_BUTTON_MASK & hasChanged) & state) {
		Nrf::PostTask([] { LockActionEventHandler(); });
	}

#ifdef CONFIG_THREAD_WIFI_SWITCHING
	if (SWITCHING_BUTTON_MASK & hasChanged) {
		SwitchButtonAction action =
			(SWITCHING_BUTTON_MASK & state) ? SwitchButtonAction::Pressed : SwitchButtonAction::Released;
		Nrf::PostTask([action] { SwitchTransportTriggerHandler(action); });
	}
#endif
}

void AppTask::LockActionEventHandler()
{
	if (BoltLockMgr().IsLocked()) {
		BoltLockMgr().Unlock(BoltLockManager::OperationSource::kButton);
	} else {
		BoltLockMgr().Lock(BoltLockManager::OperationSource::kButton);
	}
}

#ifdef CONFIG_THREAD_WIFI_SWITCHING
void AppTask::SwitchTransportEventHandler()
{
	LOG_INF("Switching to %s", ThreadWifiSwitch::IsThreadActive() ? "Wi-Fi" : "Thread");

	ThreadWifiSwitch::SwitchTransport();
}

void AppTask::SwitchTransportTimerTimeoutCallback(k_timer *timer)
{
	Nrf::PostTask([] { SwitchTransportEventHandler(); });
}

void AppTask::SwitchTransportTriggerHandler(const SwitchButtonAction &action)
{
	if (action == SwitchButtonAction::Pressed) {
		LOG_INF("Keep button pressed for %u ms to switch to %s", kSwitchTransportTimeout,
			ThreadWifiSwitch::IsThreadActive() ? "Wi-Fi" : "Thread");
		k_timer_start(&sSwitchTransportTimer, K_MSEC(kSwitchTransportTimeout), K_NO_WAIT);
	} else {
		LOG_INF("Switching to %s cancelled", ThreadWifiSwitch::IsThreadActive() ? "Wi-Fi" : "Thread");
		k_timer_stop(&sSwitchTransportTimer);
	}
}
#endif

void AppTask::LockStateChanged(const BoltLockManager::StateData &stateData)
{
	switch (stateData.mState) {
	case BoltLockManager::State::kLockingInitiated:
		LOG_INF("Lock action initiated");
		Nrf::GetBoard().GetLED(Nrf::DeviceLeds::LED2).Blink(50, 50);
#ifdef CONFIG_CHIP_NUS
		Nrf::GetNUSService().SendData("locking", sizeof("locking"));
#endif
		break;
	case BoltLockManager::State::kLockingCompleted:
		LOG_INF("Lock action completed");
		Nrf::GetBoard().GetLED(Nrf::DeviceLeds::LED2).Set(true);
#ifdef CONFIG_CHIP_NUS
		Nrf::GetNUSService().SendData("locked", sizeof("locked"));
#endif
		break;
	case BoltLockManager::State::kUnlockingInitiated:
		LOG_INF("Unlock action initiated");
		Nrf::GetBoard().GetLED(Nrf::DeviceLeds::LED2).Blink(50, 50);
#ifdef CONFIG_CHIP_NUS
		Nrf::GetNUSService().SendData("unlocking", sizeof("unlocking"));
#endif
		break;
	case BoltLockManager::State::kUnlockingCompleted:
		LOG_INF("Unlock action completed");
#ifdef CONFIG_CHIP_NUS
		Nrf::GetNUSService().SendData("unlocked", sizeof("unlocked"));
#endif
		Nrf::GetBoard().GetLED(Nrf::DeviceLeds::LED2).Set(false);
		break;
	}

	/* Handle changing attribute state in the application */
	Instance().UpdateClusterState(stateData);
}

void AppTask::UpdateClusterState(const BoltLockManager::StateData &stateData)
{
	BoltLockManager::StateData *stateDataCopy = Platform::New<BoltLockManager::StateData>(stateData);

	if (stateDataCopy == nullptr) {
		LOG_ERR("Failed to allocate memory for BoltLockManager::StateData");
		return;
	}

	CHIP_ERROR err = SystemLayer().ScheduleLambda([stateDataCopy]() {
		UpdateClusterStateHandler(*stateDataCopy);
		Platform::Delete(stateDataCopy);
	});

	if (err != CHIP_NO_ERROR) {
		LOG_ERR("Failed to schedule lambda: %" CHIP_ERROR_FORMAT, err.Format());
		Platform::Delete(stateDataCopy);
	}
}

void AppTask::UpdateClusterStateHandler(const BoltLockManager::StateData &stateData)
{
	using namespace chip::app::Clusters::DoorLock::Attributes;

	DlLockState newLockState;

	switch (stateData.mState) {
	case BoltLockManager::State::kLockingCompleted:
		newLockState = DlLockState::kLocked;
		break;
	case BoltLockManager::State::kUnlockingCompleted:
		newLockState = DlLockState::kUnlocked;
		break;
	default:
		newLockState = DlLockState::kNotFullyLocked;
		break;
	}

	Nullable<DlLockState> currentLockState;
	LockState::Get(kLockEndpointId, currentLockState);

	if (currentLockState.IsNull()) {
		/* Initialize lock state with start value, but not invoke lock/unlock. */
		LockState::Set(kLockEndpointId, newLockState);
	} else {
		LOG_INF("Updating LockState attribute");

		Nullable<uint16_t> userId;
		Nullable<List<const LockOpCredentials>> credentials;
#ifdef CONFIG_LOCK_PASS_CREDENTIALS_TO_SET_LOCK_STATE
		List<const LockOpCredentials> credentialList;
#endif

		if (!stateData.mValidatePINResult.IsNull()) {
			userId = { stateData.mValidatePINResult.Value().mUserId };

#ifdef CONFIG_LOCK_PASS_CREDENTIALS_TO_SET_LOCK_STATE
			/* `DoorLockServer::SetLockState` exptects list of `LockOpCredentials`,
			   however in case of PIN validation it makes no sense to have more than one
			   credential corresponding to validation result. For simplicity we wrap single
			   credential in list here. */
			credentialList = { &stateData.mValidatePINResult.Value().mCredential, 1 };
			credentials = { credentialList };
#endif
		}

		if (!DoorLockServer::Instance().SetLockState(kLockEndpointId, newLockState, stateData.mSource, userId,
							     credentials, stateData.mFabricIdx, stateData.mNodeId)) {
			LOG_ERR("Failed to update LockState attribute");
		}
	}
}

#ifdef CONFIG_CHIP_NUS
void AppTask::NUSLockCallback(void *context)
{
	LOG_DBG("Received LOCK command from NUS");
	if (BoltLockMgr().GetState().mState == BoltLockManager::State::kLockingCompleted ||
	    BoltLockMgr().GetState().mState == BoltLockManager::State::kLockingInitiated) {
		LOG_INF("Device is already locked");
	} else {
		Nrf::PostTask([] { LockActionEventHandler(); });
	}
}

void AppTask::NUSUnlockCallback(void *context)
{
	LOG_DBG("Received UNLOCK command from NUS");
	if (BoltLockMgr().GetState().mState == BoltLockManager::State::kUnlockingCompleted ||
	    BoltLockMgr().GetState().mState == BoltLockManager::State::kUnlockingInitiated) {
		LOG_INF("Device is already unlocked");
	} else {
		Nrf::PostTask([] { LockActionEventHandler(); });
	}
}
#endif

#ifdef CONFIG_NCS_SAMPLE_MATTER_TEST_EVENT_TRIGGERS
CHIP_ERROR AppTask::DoorLockJammedEventCallback(Nrf::Matter::TestEventTrigger::TriggerValue)
{
	VerifyOrReturnError(DoorLockServer::Instance().SendLockAlarmEvent(kLockEndpointId, AlarmCodeEnum::kLockJammed),
			    CHIP_ERROR_INTERNAL);
	LOG_ERR("Event Trigger: Doorlock jammed.");
	return CHIP_NO_ERROR;
}
#endif

CHIP_ERROR AppTask::Init()
{
	/* Initialize Matter stack */
#ifdef CONFIG_THREAD_WIFI_SWITCHING
	/* In the Thread/Wi-Fi switchable mode, it is the ThreadWifiSwitch module that owns the NetworkCommissioning
	   instances, so offload the initialization module from controlling that by explicitly setting the
	   mNetworkingInstance parameter to nullptr. Otherwise, the initialization module instantiates the
	   NetworkCommissioning object and handles it by default internally. */
	ReturnErrorOnFailure(Nrf::Matter::PrepareServer(Nrf::Matter::InitData{ .mNetworkingInstance = nullptr }));
#else
	ReturnErrorOnFailure(Nrf::Matter::PrepareServer());
#endif

	if (!Nrf::GetBoard().Init(ButtonEventHandler)) {
		LOG_ERR("User interface initialization failed.");
		return CHIP_ERROR_INCORRECT_STATE;
	}

	/* Register Matter event handler that controls the connectivity status LED based on the captured Matter network
	 * state. */
	ReturnErrorOnFailure(Nrf::Matter::RegisterEventHandler(Nrf::Board::DefaultMatterEventHandler, 0));

#ifndef CONFIG_CHIP_FACTORY_RESET_ERASE_SETTINGS
	/* Register factory reset event handler.
	 * With this configuration we have to manually clean up the storage,
	 * as whole settings partition won't be erased.
	 * */
	ReturnErrorOnFailure(Nrf::Matter::RegisterEventHandler(AppFactoryResetHandler, 0));
#endif

#ifdef CONFIG_THREAD_WIFI_SWITCHING
	CHIP_ERROR err = ThreadWifiSwitch::StartCurrentTransport();
	if (err != CHIP_NO_ERROR) {
		LOG_ERR("ThreadWifiSwitch::StartCurrentTransport() failed: %" CHIP_ERROR_FORMAT, err.Format());
		return err;
	}

	k_timer_init(&sSwitchTransportTimer, &AppTask::SwitchTransportTimerTimeoutCallback, nullptr);
#endif

#ifdef CONFIG_CHIP_NUS
	/* Initialize Nordic UART Service for Lock purposes */
	if (!Nrf::GetNUSService().Init(kLockNUSPriority, kAdvertisingIntervalMin, kAdvertisingIntervalMax)) {
		ChipLogError(Zcl, "Cannot initialize NUS service");
	}
	Nrf::GetNUSService().RegisterCommand("Lock", sizeof("Lock"), NUSLockCallback, nullptr);
	Nrf::GetNUSService().RegisterCommand("Unlock", sizeof("Unlock"), NUSUnlockCallback, nullptr);
	if (!Nrf::GetNUSService().StartServer()) {
		LOG_ERR("GetNUSService().StartServer() failed");
	}
#endif

	/* Initialize lock manager */
	BoltLockMgr().Init(LockStateChanged);

	/* Initialize IMU manager (Priorité 2 -- lecture 6 axes, cluster Boolean State) */
	ImuMgr().Init();

	/* Register Door Lock test event trigger */
#ifdef CONFIG_NCS_SAMPLE_MATTER_TEST_EVENT_TRIGGERS
	ReturnErrorOnFailure(Nrf::Matter::TestEventTrigger::Instance().RegisterTestEventTrigger(
		kDoorLockJammedEventTriggerId,
		Nrf::Matter::TestEventTrigger::EventTrigger{ 0, DoorLockJammedEventCallback }));
#endif

	ReturnErrorOnFailure(sIdentifyCluster.Init());

	return Nrf::Matter::StartServer();
}

CHIP_ERROR AppTask::StartApp()
{
	ReturnErrorOnFailure(Init());

	while (true) {
		Nrf::DispatchNextTask();
	}

	return CHIP_NO_ERROR;
}
```

## src/imu_manager.cpp
```c
/*
 * Copyright (c) 2026 Thiery Fontaine
 *
 * SPDX-License-Identifier: LicenseRef-Nordic-5-Clause
 */

/*
 * Lecture périodique de l'IMU LSM6DS3TR-C (accéléromètre + gyroscope) et mise à
 * jour du cluster Matter Boolean State (porte ouverte/fermée) -- Priorité 2 du
 * cahier des charges (voir docs/XIAO-Door-specs.md).
 *
 * Étape volontairement simple : polling par timer classique, pas d'interruption
 * de réveil sur mouvement (le moteur bas-niveau wake-up du chip -- registres
 * WAKE_UP_THS/MD1_CFG -- n'est pas exposé par le driver Zephyr LSM6DSL standard
 * et sera une étape de suivi séparée, une fois ce pipeline de données validé sur
 * matériel réel). L'alimentation du capteur (régulateur imu_vdd) et sa
 * fréquence d'échantillonnage sont configurées au boot via devicetree/Kconfig
 * (voir boards/xiao_nrf54lm20a_nrf54lm20a_cpuapp.overlay et prj.conf) -- aucune
 * configuration matérielle à faire ici, seulement lire les échantillons.
 */

#include "imu_manager.h"
#include "app/task_executor.h"

#include <app-common/zap-generated/attributes/Accessors.h>
#include <app/clusters/boolean-state-server/CodegenIntegration.h>

#include <zephyr/device.h>
#include <zephyr/devicetree.h>
#include <zephyr/drivers/sensor.h>
#include <zephyr/logging/log.h>

#include <cmath>

LOG_MODULE_DECLARE(app, CONFIG_CHIP_APP_LOG_LEVEL);

namespace
{
constexpr chip::EndpointId kDoorEndpointId = 1;

/* Seuil "porte ouverte" du cahier des charges (XIAO-Door-specs.md §4.1.1 :
 * "Angle > 15° = Ouvert"). Référence "porte fermée" = 0°, pas de calibration
 * par unité pour l'instant (Phase 5 du cahier des charges). */
constexpr double kDoorOpenThresholdDeg = 15.0;

const struct device *ImuDevice()
{
	return DEVICE_DT_GET(DT_ALIAS(imu0));
}
} /* namespace */

ImuManager ImuManager::sInstance;

void ImuManager::Init()
{
	const struct device *imu = ImuDevice();

	if (!device_is_ready(imu)) {
		LOG_ERR("IMU device (lsm6ds3tr_c) not ready -- door state via IMU disabled");
		return;
	}

	k_timer_init(&mPollTimer, &ImuManager::PollTimerEventHandler, nullptr);
	k_timer_user_data_set(&mPollTimer, this);
	k_timer_start(&mPollTimer, K_MSEC(kPollIntervalMs), K_MSEC(kPollIntervalMs));

	LOG_INF("IMU manager initialized, polling every %u ms", kPollIntervalMs);
}

void ImuManager::PollTimerEventHandler(k_timer *timer)
{
	/* Contexte ISR (horloge système) -- on ne fait jamais d'I2C ici, on poste
	 * la lecture réelle dans le contexte de la tâche applicative, comme
	 * BoltLockManager::ActuatorTimerEventHandler. */
	ImuManagerEvent event;
	event.manager = static_cast<ImuManager *>(k_timer_user_data_get(timer));
	Nrf::PostTask([event] { PollAppEventHandler(event); });
}

void ImuManager::PollAppEventHandler(const ImuManagerEvent &event)
{
	event.manager->ReadAndUpdate();
}

void ImuManager::ReadAndUpdate()
{
	const struct device *imu = ImuDevice();

	int err = sensor_sample_fetch(imu);
	if (err) {
		LOG_ERR("IMU sample fetch failed: %d", err);
		return;
	}

	struct sensor_value accel[3];
	struct sensor_value gyro[3];

	sensor_channel_get(imu, SENSOR_CHAN_ACCEL_XYZ, accel);
	sensor_channel_get(imu, SENSOR_CHAN_GYRO_XYZ, gyro);

	const double accelX = sensor_value_to_double(&accel[0]);
	const double accelZ = sensor_value_to_double(&accel[2]);

	/* Angle d'inclinaison approximatif (roll) à partir de l'accéléromètre --
	 * axes X/Z choisis arbitrairement en l'absence de montage final sur une
	 * porte réelle ; à confirmer/ajuster en observant les valeurs pendant les
	 * tests physiques (basculer la carte à la main et vérifier dans HA que
	 * l'entity bascule au bon moment). */
	const double angleDeg = std::atan2(accelX, accelZ) * (180.0 / 3.14159265358979323846);
	const bool isOpen = std::fabs(angleDeg) > kDoorOpenThresholdDeg;
	const int32_t angleCentiDeg = static_cast<int32_t>(angleDeg * 100.0);

	LOG_INF("IMU accel=(%d.%06d, %d.%06d, %d.%06d) g, gyro=(%d, %d, %d) dps, angle=%d (x0.01 deg), door=%s",
		accel[0].val1, accel[0].val2, accel[1].val1, accel[1].val2, accel[2].val1, accel[2].val2,
		gyro[0].val1, gyro[1].val1, gyro[2].val1, angleCentiDeg, isOpen ? "open" : "closed");

	auto booleanState = chip::app::Clusters::BooleanState::FindClusterOnEndpoint(kDoorEndpointId);
	if (booleanState == nullptr) {
		LOG_ERR("Boolean State cluster not found on endpoint %u", kDoorEndpointId);
		return;
	}

	booleanState->SetStateValue(isOpen);
}
```

## src/imu_manager.h
```c
/*
 * Copyright (c) 2026 Thiery Fontaine
 *
 * SPDX-License-Identifier: LicenseRef-Nordic-5-Clause
 */

#pragma once

#include <zephyr/kernel.h>

#include <cstdint>

struct ImuManagerEvent;

class ImuManager {
public:
	void Init();

private:
	void ReadAndUpdate();

	static void PollTimerEventHandler(k_timer *timer);
	static void PollAppEventHandler(const ImuManagerEvent &event);

	static constexpr uint32_t kPollIntervalMs = 2000;

	k_timer mPollTimer = {};

	static ImuManager sInstance;
	friend ImuManager &ImuMgr();
};

inline ImuManager &ImuMgr()
{
	return ImuManager::sInstance;
}

struct ImuManagerEvent {
	ImuManager *manager;
};
```
