/* Plan-Reduction-Consommation-2026-09-22.md #9.1 -- imu_vdd/LDO1 deja
 * entierement defini dans le dtsi de base du board, pas besoin de le
 * redeclarer ici (meme constat que xiao_pdm_ldo_diag / xiao_ldo_gpio_char). */

/* Meme bug de build recurrent sur ce snapshot NCS 3.4.0 (nrf_usbhs_wrapper.c
 * ne compile pas) que partout ailleurs dans ce projet. */
&usbhs {
	status = "disabled";
};

&usbhs_wrapper {
	status = "disabled";
};
